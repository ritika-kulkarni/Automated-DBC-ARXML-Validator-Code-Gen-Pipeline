VERSION "1.0"

NS_ :

BS_:
BU_: Engine ECU

BO_ 2566848256 EEC1: 8 Engine
 SG_ EngSpeed : 24|16@1+ (0.125,0) [0|8031.875] "rpm" ECU
 SG_ EngDemandPercentTorque : 16|8@1- (1,-125) [-125|125] "%" ECU

BA_DEF_ BO_  "GenMsgCycleTime" INT 0 10000;
BA_DEF_ BO_  "VFrameFormat" ENUM  "StandardCAN","ExtendedCAN","reserved","J1939PG";
BA_DEF_ SG_  "GenSigStartValue" FLOAT 0 100000;
BA_DEF_DEF_  "GenMsgCycleTime" 0;
BA_DEF_DEF_  "VFrameFormat" "J1939PG";
BA_DEF_DEF_  "GenSigStartValue" 0;

BA_ "GenMsgCycleTime" BO_ 2566848256 10;
